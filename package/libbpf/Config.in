## package/libbpf/Config.in
```kconfig
config BR2_PACKAGE_LIBIBPF
	bool "libbpf"
	depends on BR2_TOOLCHAIN_HAS_THREADS
	select BR2_PACKAGE_LIBIEC61850
	#depends on BR2_STATIC_LIBS
	#depends on BR2_USE_MMU # fork()
	help
	  TFM de mierda

	  http://tfm-mierda.com/
```

## package/libiec61850/Config.in
```kconfig
config BR2_PACKAGE_LIBIEC61850
	bool "libiec61850"
	depends on BR2_TOOLCHAIN_HAS_THREADS
	#depends on BR2_STATIC_LIBS
	depends on BR2_USE_MMU # fork()
	help
	  TFM de mierda

	  http://tfm-mierda.com/

if BR2_PACKAGE_LIBIEC61850
config BR2_PACKAGE_LIBIEC61850_EXAMPLES
	bool "enable examples"
	help
	  Enable build of the examples.

endif
```
